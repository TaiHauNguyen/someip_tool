AUTOSAR XML (schema 00046)
standard types defined: float32, uint8
package /Communication/DataTransformation
  data transformation set TransformerConfiguration
    data transformation SomeIpDefaultTransformation: execute-despite-data-unavailability=false, transformer-chain=SomeIpDefaultTransformer
    transformation technology SomeIpDefaultTransformer: buffer-properties={header-length=64, in-place=false}, protocol=SOMEIP, someip-transformation-description{alignment=8, byte-order=little-endian, interface-version=1}, transformer-class=SERIALIZER, version=1.0.0
package /Communication/PDUs
  general purpose pdu SD_Ctrl_Rx_Multicast: category=SD, length=1500
  general purpose pdu SD_Ctrl_Rx_RMCU: category=SD, length=1500
  general purpose pdu SD_Ctrl_Tx_RMCU: category=SD, length=1500
  pdu pdu_RMCUZALeft10msEvent: length=26, transmission-mode-true-timing=event-controlled-timing=number-of-repetitions=0, unused-bit-pattern=0
    signal sig_RMCUZALeft10msEvent: start 0, 26 bit, opaque, system signal sys_RMCUZALeft10msEvent, data-transformations=SomeIpDefaultTransformation, data-type-policy=TRANSFORMING-I-SIGNAL, someip-transformation-i-signal-props{transformer=SomeIpDefaultTransformer, interface-version=1, message-type=NOTIFICATION}, transfer-property=TRIGGERED-WITHOUT-REPETITION, to ZAFL
package /SoAdRoutingGroups
  so ad routing group SoAdRG_RMCU_C_EventGroup: event-group-control-type=ACTIVATION-UNICAST
package /System
  system System: category=ECU_SYSTEM_DESCRIPTION
package /PortInterfaces
  sender receiver interface SoIp_I_C_RMCUZALeft10msEvent
    data RMCUZALeft10msEvent: type=RMCUZALeft10msStruct
package /DataTypes
  impl type RMCUZALeft10msStruct: category=STRUCTURE, sw-calibration-access=READ-ONLY, type-emitter=RTE
    element rmcuAbility: category=STRUCTURE, sw-calibration-access=READ-ONLY
      6 x element, all with category=VALUE, sw-calibration-access=READ-ONLY:
        rMCUActInputCurrent: base-type=float32
        rMCUActInputCurrentV: base-type=uint8, compu {0=RMCU_ACT_INPUT_CURRENT_V_VALID (CompuScale), 1=RMCU_ACT_INPUT_CURRENT_V_INVALID (CompuScale_1)}, range raw 0..255
        rMCUActInputVolt: base-type=float32
        rMCUActInputVoltV: base-type=uint8, compu {0=RMCU_ACT_INPUT_VOLT_V_VALID (CompuScale), 1=RMCU_ACT_INPUT_VOLT_V_INVALID (CompuScale_1)}, range raw 0..255
        rMCUCVCNegTrqLmt: base-type=float32
        rMCUCVCPosTrqLmt: base-type=float32
package /Topology/Clusters
  ethernet cluster EthernetCluster: baudrate=100000000
    ethernet physical channel ChannelCommunication: category=WIRED, comm-connectors=CN_ZAFL_EthernetCluster
      pdu triggering PT_RMCUZALeft10msEvent: pdu=pdu_RMCUZALeft10msEvent, to ZAFL
      pdu triggering PT_SD_Ctrl_Rx_Multicast: pdu=SD_Ctrl_Rx_Multicast, to ZAFL
      pdu triggering PT_SD_Ctrl_RMCU_Rx: pdu=SD_Ctrl_Rx_RMCU, to ZAFL
      pdu triggering PT_SD_Ctrl_RMCU_Tx: pdu=SD_Ctrl_Tx_RMCU, from ZAFL
      4 x network endpoint:
        NEP_ANY_SD: network-endpoint-addresses=ipv-4-configuration=ipv-4-address=ANY
        NEP_MC
          network-endpoint-addresses:
            ipv-4-configuration={ipv-4-address=239.192.255.251, ipv-4-address-source=FIXED}
            mac-multicast-configuration=MulticastMacAddress
        NEP_RMCU: network-endpoint-addresses=ipv-4-configuration={ipv-4-address=192.168.1.2, ipv-4-address-source=FIXED, network-mask=255.255.255.0}
        NEP_IVA: network-endpoint-addresses=ipv-4-configuration={ipv-4-address=ANY, ipv-4-address-source=FIXED, network-mask=255.255.255.0}
      so-ad-config:
        4 x socket connection bundle:
          SCB_RMCU: socket-connection{client-ip-addr-from-connection-request=false, client-port-from-connection-request=false, client-port=SA_RMCU, short-label=SC_RMCU}, pdus=socket-connection-ipdu-identifier={header-id=1343193090, pdu-triggering=PT_RMCUZALeft10msEvent, routing-group=SoAdRG_RMCU_C_EventGroup}, server-port=SA_IVA_RMCU
          SD_SCB_RMCU: socket-connection{client-ip-addr-from-connection-request=true, client-port-from-connection-request=true, client-port=SD_SA_ANY, pdus=[{header-id=4294934784, pdu-triggering=PT_SD_Ctrl_RMCU_Rx}, {header-id=4294934784, pdu-triggering=PT_SD_Ctrl_RMCU_Tx}], short-label=SD_SCB_RMCU_SC}, server-port=SD_SA_RMCU
          SD_SCB_IVA: socket-connection{client-ip-addr-from-connection-request=true, client-port-from-connection-request=true, client-port=SD_SA_ANY, short-label=SD_SCB_IVA_SC}, server-port=SD_SA_IVA
          SD_SCB_MC: socket-connection{client-ip-addr-from-connection-request=true, client-port-from-connection-request=true, client-port=SD_SA_ANY, pdus=socket-connection-ipdu-identifier={header-id=4294934784, pdu-triggering=PT_SD_Ctrl_Rx_Multicast}, short-label=SD_SCB_MC_SC}, server-port=SD_SA_MC
        6 x socket address:
          SA_RMCU: connector=CN_ZAFL_EthernetCluster
            application endpoint AEP_RMCU: network-endpoint=NEP_RMCU, tp-configuration=udp-tp=udp-tp-port=port-number=40152
              consumed service instance CSI_RMCU: routing-group=SoAdRG_RMCU_C_EventGroup, provided-service-instance=PSI_IVA_RMCU, sd-client-config={client-service-major-version=1, client-service-minor-version=0, initial-find-behavior={initial-delay-max-value=0.05, initial-delay-min-value=0.05, initial-repetitions-base-delay=0.1, initial-repetitions-max=3}, ttl=3}
                consumed event group CEG_RMCUZALeftEvents: application-endpoint=AEP_RMCU, event-group-identifier=2, routing-group=SoAdRG_RMCU_C_EventGroup, sd-client-config={request-response-delay={max-value=0.2, min-value=0.02}, ttl=3}
          SA_IVA_RMCU
            application endpoint AEP_IVA_RMCU: network-endpoint=NEP_IVA, tp-configuration=udp-tp=udp-tp-port=port-number=30500
              provided service instance PSI_IVA_RMCU:
                routing-group=SoAdRG_RMCU_C_EventGroup
                instance-identifier=24591
                sd-server-config={initial-offer-behavior={initial-delay-max-value=0.05, initial-delay-min-value=0.05, initial-repetitions-base-delay=0.1, initial-repetitions-max=3}, offer-cyclic-delay=2, request-response-delay={max-value=0.2, min-value=0.02}, server-service-major-version=1, server-service-minor-version=0, ttl=3}
                service-identifier=20495
                event handler EH_RMCUZALeftEvents: application-endpoint=AEP_IVA_RMCU, consumed-event-group=CEG_RMCUZALeftEvents, multicast-threshold=0, routing-group=SoAdRG_RMCU_C_EventGroup, sd-server-config={request-response-delay={max-value=0.2, min-value=0.02}, ttl=3}
          SD_SA_ANY
            application endpoint SD_AEP_ANY: network-endpoint=NEP_ANY_SD, tp-configuration=udp-tp=udp-tp-port=dynamically-assigned=true
          SD_SA_RMCU
            application endpoint SD_AEP_RMCU: network-endpoint=NEP_RMCU, tp-configuration=udp-tp=udp-tp-port=port-number=30490
          SD_SA_IVA
            application endpoint SD_AEP_IVA: network-endpoint=NEP_IVA, tp-configuration=udp-tp=udp-tp-port=port-number=30490
          SD_SA_MC: multicast-connector=CN_ZAFL_EthernetCluster
            application endpoint SD_AEP_MC: network-endpoint=NEP_MC, tp-configuration=udp-tp=udp-tp-port=port-number=30490
      vlan Vlan: vlan-identifier=5
    mac multicast group MulticastMacAddress: mac-multicast-address=01:00:5E:00:00:00
package /Topology/HardwareComponents
  ecu instance ZAFL: com-configuration-tx-time-base=0.01, sleep-mode-supported=false, wake-up-over-bus-supported=false
    ethernet communication controller CT_ZAFL_EthernetCluster: category=WIRED, mac-unicast-address=02:20:00:00:00:02
      coupling port CN_ZAFL_EthernetCluster: physical-layer-type=100BASE-T1, vlan-membership{default-priority=6, vlan=ChannelCommunication}
    ethernet communication connector CN_ZAFL_EthernetCluster: category=WIRED, comm-controller=CT_ZAFL_EthernetCluster, network-endpoint=[NEP_MC, NEP_RMCU, NEP_IVA]
