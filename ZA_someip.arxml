AUTOSAR XML (schema 00046)
standard types defined: uint8
package /Communication/DataTransformation
  data transformation set TransformerConfiguration
    data transformation SomeIpDefaultTransformation: execute-despite-data-unavailability=false, transformer-chain=SomeIpDefaultTransformer
    transformation technology SomeIpDefaultTransformer: buffer-properties={header-length=64, in-place=false}, protocol=SOMEIP, someip-transformation-description{alignment=8, byte-order=little-endian, interface-version=1}, transformer-class=SERIALIZER, version=1.0.0
package /Communication/PDUs
  general purpose pdu SD_Ctrl_Rx_Multicast: category=SD, length=1500
  general purpose pdu SD_Ctrl_Rx_ZAFL: category=SD, length=1500
  general purpose pdu SD_Ctrl_Tx_ZAFL: category=SD, length=1500
  pdu pdu_ACMIVA20msACUCrashInfoEvent: length=16, transmission-mode-true-timing=event-controlled-timing=number-of-repetitions=0
    signal sig_ACMIVA20msACUCrashInfoEvent: start 0, 16 bit, opaque, system signal sys_ACMIVA20msACUCrashInfoEvent, data-transformations=SomeIpDefaultTransformation, data-type-policy=TRANSFORMING-I-SIGNAL, someip-transformation-i-signal-props{transformer=SomeIpDefaultTransformer, interface-version=1, message-type=NOTIFICATION}, transfer-property=TRIGGERED-WITHOUT-REPETITION
  pdu pdu_ACMIVA20msACUOccupantStatusEvent: length=13, transmission-mode-true-timing=event-controlled-timing=number-of-repetitions=0
    signal sig_ACMIVA20msACUOccupantStatusEvent: start 0, 13 bit, opaque, system signal sys_ACMIVA20msACUOccupantStatusEvent, data-transformations=SomeIpDefaultTransformation, data-type-policy=TRANSFORMING-I-SIGNAL, someip-transformation-i-signal-props{transformer=SomeIpDefaultTransformer, interface-version=1, message-type=NOTIFICATION}, transfer-property=TRIGGERED-WITHOUT-REPETITION
  pdu pdu_ACMZARight20msACUCrashInfoEvent: length=16, transmission-mode-true-timing=event-controlled-timing=number-of-repetitions=0
    signal sig_ACMZARight20msACUCrashInfoEvent: start 0, 16 bit, opaque, system signal sys_ACMZARight20msACUCrashInfoEvent, data-transformations=SomeIpDefaultTransformation, data-type-policy=TRANSFORMING-I-SIGNAL, someip-transformation-i-signal-props{transformer=SomeIpDefaultTransformer, interface-version=1, message-type=NOTIFICATION}, transfer-property=TRIGGERED-WITHOUT-REPETITION
  pdu pdu_ACMZARight20msACUOccupantStatusEvent: length=13, transmission-mode-true-timing=event-controlled-timing=number-of-repetitions=0
    signal sig_ACMZARight20msACUOccupantStatusEvent: start 0, 13 bit, opaque, system signal sys_ACMZARight20msACUOccupantStatusEvent, data-transformations=SomeIpDefaultTransformation, data-type-policy=TRANSFORMING-I-SIGNAL, someip-transformation-i-signal-props{transformer=SomeIpDefaultTransformer, interface-version=1, message-type=NOTIFICATION}, transfer-property=TRIGGERED-WITHOUT-REPETITION
  pdu pdu_ACMZARear20msACUCrashInfoEvent: length=16, transmission-mode-true-timing=event-controlled-timing=number-of-repetitions=0
    signal sig_ACMZARear20msACUCrashInfoEvent: start 0, 16 bit, opaque, system signal sys_ACMZARear20msACUCrashInfoEvent, data-transformations=SomeIpDefaultTransformation, data-type-policy=TRANSFORMING-I-SIGNAL, someip-transformation-i-signal-props{transformer=SomeIpDefaultTransformer, interface-version=1, message-type=NOTIFICATION}, transfer-property=TRIGGERED-WITHOUT-REPETITION
  pdu pdu_ACMZARear20msACUOccupantStatusEvent: length=13, transmission-mode-true-timing=event-controlled-timing=number-of-repetitions=0
    signal sig_ACMZARear20msACUOccupantStatusEvent: start 0, 13 bit, opaque, system signal sys_ACMZARear20msACUOccupantStatusEvent, data-transformations=SomeIpDefaultTransformation, data-type-policy=TRANSFORMING-I-SIGNAL, someip-transformation-i-signal-props{transformer=SomeIpDefaultTransformer, interface-version=1, message-type=NOTIFICATION}, transfer-property=TRIGGERED-WITHOUT-REPETITION
package /SoAdRoutingGroups
  so ad routing group SoAdRG_PCU_ACMIVAEvents_PEG: event-group-control-type=ACTIVATION-UNICAST
  so ad routing group SoAdRG_PCU_ACMZARightEvents_PEG: event-group-control-type=ACTIVATION-UNICAST
  so ad routing group SoAdRG_PCU_ACMZARearEvents_PEG: event-group-control-type=ACTIVATION-UNICAST
package /System
  system System: category=ECU_SYSTEM_DESCRIPTION
package /PortInterfaces
  6 x sender receiver interface:
    SoIp_I_P_ACMIVA20msACUCrashInfoEvent
      data ACMIVA20msACUCrashInfoEvent: type=ACUCrashInfoStruct
    SoIp_I_P_ACMIVA20msACUOccupantStatusEvent
      data ACMIVA20msACUOccupantStatusEvent: type=ACUOccupantStatusStruct
    SoIp_I_P_ACMZARight20msACUCrashInfoEvent
      data ACMZARight20msACUCrashInfoEvent: type=ACUCrashInfoStruct
    SoIp_I_P_ACMZARight20msACUOccupantStatusEvent
      data ACMZARight20msACUOccupantStatusEvent: type=ACUOccupantStatusStruct
    SoIp_I_P_ACMZARear20msACUCrashInfoEvent
      data ACMZARear20msACUCrashInfoEvent: type=ACUCrashInfoStruct
    SoIp_I_P_ACMZARear20msACUOccupantStatusEvent
      data ACMZARear20msACUOccupantStatusEvent: type=ACUOccupantStatusStruct
package /DataTypes
  impl type ACUCrashInfoStruct: category=STRUCTURE, sw-calibration-access=READ-ONLY, type-emitter=RTE
    8 x element, all with category=VALUE, base-type=uint8:
      CRC_ACU_CRASH_INFO: sw-calibration-access=READ-ONLY
      Byte1: sw-calibration-access=READ-ONLY
      Byte2: compu {mask 224: 0=ACU_Crash_Intensity_ACU_CRASH_INTENSITY_NO_CRASH, mask 224: 32=ACU_Crash_Intensity_ACU_CRASH_INTENSITY_CRASH_INTENSITY1, mask 224: 64=ACU_Crash_Intensity_ACU_CRASH_INTENSITY_CRASH_INTENSITY2, mask 224: 96=ACU_Crash_Intensity_ACU_CRASH_INTENSITY_CRASH_INTENSITY3, mask 24: 0=ACU_Airbag_Deployment_Status_ACU_AIRBAG_DEPLOYMENT_STATUS_NO_AIRBAG_DEPLOYMENT, mask 24: 8=ACU_Airbag_Deployment_Status_ACU_AIRBAG_DEPLOYMENT_STATUS_AIRBAG_DEPLOYMENT, mask 6: 0=ACU_Crash_Sts_ACU_CRASH_STS_NO_EVENT, mask 6: 2=ACU_Crash_Sts_ACU_CRASH_STS_CRASH_DETECTED}, range raw 0..255
      Byte3: compu {mask 192: 0=ACU_Rear_Crash_ACU_REAR_CRASH_NO_EVENT, mask 192: 64=ACU_Rear_Crash_ACU_REAR_CRASH_REAR_CRASH_DETECTED, mask 48: 0=ACU_PassSide_Crash_ACU_PASS_SIDE_CRASH_NO_EVENT, mask 48: 16=ACU_PassSide_Crash_ACU_PASS_SIDE_CRASH_PAS_SIDE_CRASH_DETECTED, mask 12: 0=ACU_DriverSide_Crash_ACU_DRIVER_SIDE_CRASH_NO_EVENT, mask 12: 4=ACU_DriverSide_Crash_ACU_DRIVER_SIDE_CRASH_DRIVERSIDE_CRASH_DETECTED, mask 3: 0=ACU_Front_Crash_ACU_FRONT_CRASH_NO_EVENT, mask 3: 1=ACU_Front_Crash_ACU_FRONT_CRASH_FRONT_CRASH_DETECTED}, range raw 0..255
      Byte4: compu {mask 3: 0=ACU_Rollover_Crash_ACU_ROLLOVER_CRASH_NO_EVENT, mask 3: 1=ACU_Rollover_Crash_ACU_ROLLOVER_CRASH_ROLLOVER_CRASH_DETECTED}, range raw 0..255
      Reserved_{4..6}: sw-calibration-access=READ-ONLY
  impl type ACUOccupantStatusStruct: category=STRUCTURE, sw-calibration-access=READ-ONLY, type-emitter=RTE
    5 x element, all with category=VALUE, base-type=uint8:
      CRC_ACU_OCCUPANT_STATUS: sw-calibration-access=READ-ONLY
      Byte1: sw-calibration-access=READ-ONLY
      Byte2: compu {mask 192: 0=ACU_Seat_Occupancy_2nd_Row_Mid_ACU_SEAT_OCCUPANCY2ND_ROW_MID_SEAT_NOT_OCCUPIED, mask 192: 64=ACU_Seat_Occupancy_2nd_Row_Mid_ACU_SEAT_OCCUPANCY2ND_ROW_MID_SEAT_OCCUPIED, mask 192: 128=ACU_Seat_Occupancy_2nd_Row_Mid_ACU_SEAT_OCCUPANCY2ND_ROW_MID_NOT_AVAILABLE, mask 192: 192=ACU_Seat_Occupancy_2nd_Row_Mid_ACU_SEAT_OCCUPANCY2ND_ROW_MID_FAILURE, mask 48: 0=ACU_Seat_Occupancy_2nd_Row_Pas_ACU_SEAT_OCCUPANCY2ND_ROW_PAS_SEAT_NOT_OCCUPIED, mask 48: 16=ACU_Seat_Occupancy_2nd_Row_Pas_ACU_SEAT_OCCUPANCY2ND_ROW_PAS_SEAT_OCCUPIED, mask 48: 32=ACU_Seat_Occupancy_2nd_Row_Pas_ACU_SEAT_OCCUPANCY2ND_ROW_PAS_NOT_AVAILABLE, mask 48: 48=ACU_Seat_Occupancy_2nd_Row_Pas_ACU_SEAT_OCCUPANCY2ND_ROW_PAS_FAILURE, mask 12: 0=ACU_Seat_Occupancy_2nd_Row_Dri_ACU_SEAT_OCCUPANCY2ND_ROW_DRI_SEAT_NOT_OCCUPIED, mask 12: 4=ACU_Seat_Occupancy_2nd_Row_Dri_ACU_SEAT_OCCUPANCY2ND_ROW_DRI_SEAT_OCCUPIED, mask 12: 8=ACU_Seat_Occupancy_2nd_Row_Dri_ACU_SEAT_OCCUPANCY2ND_ROW_DRI_NOT_AVAILABLE, mask 12: 12=ACU_Seat_Occupancy_2nd_Row_Dri_ACU_SEAT_OCCUPANCY2ND_ROW_DRI_FAILURE, mask 3: 0=ACU_Seat_Occupancy_Passenger_ACU_SEAT_OCCUPANCY_PASSENGER_SEAT_NOT_OCCUPIED, mask 3: 1=ACU_Seat_Occupancy_Passenger_ACU_SEAT_OCCUPANCY_PASSENGER_SEAT_OCCUPIED, mask 3: 2=ACU_Seat_Occupancy_Passenger_ACU_SEAT_OCCUPANCY_PASSENGER_NOT_AVAILABLE, mask 3: 3=ACU_Seat_Occupancy_Passenger_ACU_SEAT_OCCUPANCY_PASSENGER_FAILURE}, range raw 0..255
      Byte3: compu {mask 192: 0=ACU_Seat_Belt_Status_2nd_Row_Mid_ACU_SEAT_BELT_STATUS2ND_ROW_MID_NOT_BUCKLED, mask 192: 64=ACU_Seat_Belt_Status_2nd_Row_Mid_ACU_SEAT_BELT_STATUS2ND_ROW_MID_BUCKLED, mask 192: 128=ACU_Seat_Belt_Status_2nd_Row_Mid_ACU_SEAT_BELT_STATUS2ND_ROW_MID_NOT_AVAILABLE, mask 192: 192=ACU_Seat_Belt_Status_2nd_Row_Mid_ACU_SEAT_BELT_STATUS2ND_ROW_MID_FAILURE, mask 48: 0=ACU_Seat_Belt_Status_2nd_Row_Dri_ACU_SEAT_BELT_STATUS2ND_ROW_DRI_NOT_BUCKLED, mask 48: 16=ACU_Seat_Belt_Status_2nd_Row_Dri_ACU_SEAT_BELT_STATUS2ND_ROW_DRI_BUCKLED, mask 48: 32=ACU_Seat_Belt_Status_2nd_Row_Dri_ACU_SEAT_BELT_STATUS2ND_ROW_DRI_NOT_AVAILABLE, mask 48: 48=ACU_Seat_Belt_Status_2nd_Row_Dri_ACU_SEAT_BELT_STATUS2ND_ROW_DRI_FAILURE, mask 12: 0=ACU_Seat_Belt_Status_Driver_ACU_SEAT_BELT_STATUS_DRIVER_NOT_BUCKLED, mask 12: 4=ACU_Seat_Belt_Status_Driver_ACU_SEAT_BELT_STATUS_DRIVER_BUCKLED, mask 12: 8=ACU_Seat_Belt_Status_Driver_ACU_SEAT_BELT_STATUS_DRIVER_NOT_AVAILABLE, mask 12: 12=ACU_Seat_Belt_Status_Driver_ACU_SEAT_BELT_STATUS_DRIVER_FAILURE, mask 3: 0=ACU_Seat_Belt_Status_Passenger_ACU_SEAT_BELT_STATUS_PASSENGER_NOT_BUCKLED, mask 3: 1=ACU_Seat_Belt_Status_Passenger_ACU_SEAT_BELT_STATUS_PASSENGER_BUCKLED, mask 3: 2=ACU_Seat_Belt_Status_Passenger_ACU_SEAT_BELT_STATUS_PASSENGER_NOT_AVAILABLE, mask 3: 3=ACU_Seat_Belt_Status_Passenger_ACU_SEAT_BELT_STATUS_PASSENGER_FAILURE}, range raw 0..255
      Byte4: compu {mask 12: 0=ACU_Seat_Occupancy_Driver_ACU_SEAT_OCCUPANCY_DRIVER_SEAT_NOT_OCCUPIED, mask 12: 4=ACU_Seat_Occupancy_Driver_ACU_SEAT_OCCUPANCY_DRIVER_SEAT_OCCUPIED, mask 12: 8=ACU_Seat_Occupancy_Driver_ACU_SEAT_OCCUPANCY_DRIVER_NOT_AVAILABLE, mask 12: 12=ACU_Seat_Occupancy_Driver_ACU_SEAT_OCCUPANCY_DRIVER_FAILURE, mask 3: 0=ACU_Seat_Belt_Status_2nd_Row_Pas_ACU_SEAT_BELT_STATUS2ND_ROW_PAS_NOT_BUCKLED, mask 3: 1=ACU_Seat_Belt_Status_2nd_Row_Pas_ACU_SEAT_BELT_STATUS2ND_ROW_PAS_BUCKLED, mask 3: 2=ACU_Seat_Belt_Status_2nd_Row_Pas_ACU_SEAT_BELT_STATUS2ND_ROW_PAS_NOT_AVAILABLE, mask 3: 3=ACU_Seat_Belt_Status_2nd_Row_Pas_ACU_SEAT_BELT_STATUS2ND_ROW_PAS_FAILURE}, range raw 0..255
package /DataTypes/CompuMethods
  compu method ACUCrashStsType: 0=ACU_CRASH_STS_NO_EVENT (CompuScale), 1=ACU_CRASH_STS_CRASH_DETECTED (CompuScale_1)
  compu method ACUAirbagDeploymentStatusType: 0=ACU_AIRBAG_DEPLOYMENT_STATUS_NO_AIRBAG_DEPLOYMENT (CompuScale), 1=ACU_AIRBAG_DEPLOYMENT_STATUS_AIRBAG_DEPLOYMENT (CompuScale_1)
  compu method ACUCrashIntensityType: 0=ACU_CRASH_INTENSITY_NO_CRASH (CompuScale), 1=ACU_CRASH_INTENSITY_CRASH_INTENSITY1 (CompuScale_1), 2=ACU_CRASH_INTENSITY_CRASH_INTENSITY2 (CompuScale_2), 3=ACU_CRASH_INTENSITY_CRASH_INTENSITY3 (CompuScale_3)
  compu method ACUFrontCrashType: 0=ACU_FRONT_CRASH_NO_EVENT (CompuScale), 1=ACU_FRONT_CRASH_FRONT_CRASH_DETECTED (CompuScale_1)
  compu method ACUDriverSideCrashType: 0=ACU_DRIVER_SIDE_CRASH_NO_EVENT (CompuScale), 1=ACU_DRIVER_SIDE_CRASH_DRIVERSIDE_CRASH_DETECTED (CompuScale_1)
  compu method ACUPassSideCrashType: 0=ACU_PASS_SIDE_CRASH_NO_EVENT (CompuScale), 1=ACU_PASS_SIDE_CRASH_PAS_SIDE_CRASH_DETECTED (CompuScale_1)
  compu method ACURearCrashType: 0=ACU_REAR_CRASH_NO_EVENT (CompuScale), 1=ACU_REAR_CRASH_REAR_CRASH_DETECTED (CompuScale_1)
  compu method ACURolloverCrashType: 0=ACU_ROLLOVER_CRASH_NO_EVENT (CompuScale), 1=ACU_ROLLOVER_CRASH_ROLLOVER_CRASH_DETECTED (CompuScale_1)
  compu method ACUSeatOccupancyPassengerType: 0=ACU_SEAT_OCCUPANCY_PASSENGER_SEAT_NOT_OCCUPIED (CompuScale), 1=ACU_SEAT_OCCUPANCY_PASSENGER_SEAT_OCCUPIED (CompuScale_1), 2=ACU_SEAT_OCCUPANCY_PASSENGER_NOT_AVAILABLE (CompuScale_2), 3=ACU_SEAT_OCCUPANCY_PASSENGER_FAILURE (CompuScale_3)
  compu method ACUSeatOccupancy2ndRowDriType: 0=ACU_SEAT_OCCUPANCY2ND_ROW_DRI_SEAT_NOT_OCCUPIED (CompuScale), 1=ACU_SEAT_OCCUPANCY2ND_ROW_DRI_SEAT_OCCUPIED (CompuScale_1), 2=ACU_SEAT_OCCUPANCY2ND_ROW_DRI_NOT_AVAILABLE (CompuScale_2), 3=ACU_SEAT_OCCUPANCY2ND_ROW_DRI_FAILURE (CompuScale_3)
  compu method ACUSeatOccupancy2ndRowPasType: 0=ACU_SEAT_OCCUPANCY2ND_ROW_PAS_SEAT_NOT_OCCUPIED (CompuScale), 1=ACU_SEAT_OCCUPANCY2ND_ROW_PAS_SEAT_OCCUPIED (CompuScale_1), 2=ACU_SEAT_OCCUPANCY2ND_ROW_PAS_NOT_AVAILABLE (CompuScale_2), 3=ACU_SEAT_OCCUPANCY2ND_ROW_PAS_FAILURE (CompuScale_3)
  compu method ACUSeatOccupancy2ndRowMidType: 0=ACU_SEAT_OCCUPANCY2ND_ROW_MID_SEAT_NOT_OCCUPIED (CompuScale), 1=ACU_SEAT_OCCUPANCY2ND_ROW_MID_SEAT_OCCUPIED (CompuScale_1), 2=ACU_SEAT_OCCUPANCY2ND_ROW_MID_NOT_AVAILABLE (CompuScale_2), 3=ACU_SEAT_OCCUPANCY2ND_ROW_MID_FAILURE (CompuScale_3)
  compu method ACUSeatBeltStatusPassengerType: 0=ACU_SEAT_BELT_STATUS_PASSENGER_NOT_BUCKLED (CompuScale), 1=ACU_SEAT_BELT_STATUS_PASSENGER_BUCKLED (CompuScale_1), 2=ACU_SEAT_BELT_STATUS_PASSENGER_NOT_AVAILABLE (CompuScale_2), 3=ACU_SEAT_BELT_STATUS_PASSENGER_FAILURE (CompuScale_3)
  compu method ACUSeatBeltStatusDriverType: 0=ACU_SEAT_BELT_STATUS_DRIVER_NOT_BUCKLED (CompuScale), 1=ACU_SEAT_BELT_STATUS_DRIVER_BUCKLED (CompuScale_1), 2=ACU_SEAT_BELT_STATUS_DRIVER_NOT_AVAILABLE (CompuScale_2), 3=ACU_SEAT_BELT_STATUS_DRIVER_FAILURE (CompuScale_3)
  compu method ACUSeatBeltStatus2ndRowDriType: 0=ACU_SEAT_BELT_STATUS2ND_ROW_DRI_NOT_BUCKLED (CompuScale), 1=ACU_SEAT_BELT_STATUS2ND_ROW_DRI_BUCKLED (CompuScale_1), 2=ACU_SEAT_BELT_STATUS2ND_ROW_DRI_NOT_AVAILABLE (CompuScale_2), 3=ACU_SEAT_BELT_STATUS2ND_ROW_DRI_FAILURE (CompuScale_3)
  compu method ACUSeatBeltStatus2ndRowMidType: 0=ACU_SEAT_BELT_STATUS2ND_ROW_MID_NOT_BUCKLED (CompuScale), 1=ACU_SEAT_BELT_STATUS2ND_ROW_MID_BUCKLED (CompuScale_1), 2=ACU_SEAT_BELT_STATUS2ND_ROW_MID_NOT_AVAILABLE (CompuScale_2), 3=ACU_SEAT_BELT_STATUS2ND_ROW_MID_FAILURE (CompuScale_3)
  compu method ACUSeatBeltStatus2ndRowPasType: 0=ACU_SEAT_BELT_STATUS2ND_ROW_PAS_NOT_BUCKLED (CompuScale), 1=ACU_SEAT_BELT_STATUS2ND_ROW_PAS_BUCKLED (CompuScale_1), 2=ACU_SEAT_BELT_STATUS2ND_ROW_PAS_NOT_AVAILABLE (CompuScale_2), 3=ACU_SEAT_BELT_STATUS2ND_ROW_PAS_FAILURE (CompuScale_3)
  compu method ACUSeatOccupancyDriverType: 0=ACU_SEAT_OCCUPANCY_DRIVER_SEAT_NOT_OCCUPIED (CompuScale), 1=ACU_SEAT_OCCUPANCY_DRIVER_SEAT_OCCUPIED (CompuScale_1), 2=ACU_SEAT_OCCUPANCY_DRIVER_NOT_AVAILABLE (CompuScale_2), 3=ACU_SEAT_OCCUPANCY_DRIVER_FAILURE (CompuScale_3)
package /DataTypes/DataConstraints
  range ACUCrashStsconst: raw 0..255
  range ACUAirbagDeploymentStatusconst: raw 0..255
  range ACUCrashIntensityconst: raw 0..255
  range ACUFrontCrashconst: raw 0..255
  range ACUDriverSideCrashconst: raw 0..255
  range ACUPassSideCrashconst: raw 0..255
  range ACURearCrashconst: raw 0..255
  range ACURolloverCrashconst: raw 0..255
  range ACUSeatOccupancyPassengerconst: raw 0..255
  range ACUSeatOccupancy2ndRowDriconst: raw 0..255
  range ACUSeatOccupancy2ndRowPasconst: raw 0..255
  range ACUSeatOccupancy2ndRowMidconst: raw 0..255
  range ACUSeatBeltStatusPassengerconst: raw 0..255
  range ACUSeatBeltStatusDriverconst: raw 0..255
  range ACUSeatBeltStatus2ndRowDriconst: raw 0..255
  range ACUSeatBeltStatus2ndRowMidconst: raw 0..255
  range ACUSeatBeltStatus2ndRowPasconst: raw 0..255
  range ACUSeatOccupancyDriverconst: raw 0..255
package /Topology/Clusters
  ethernet cluster EthernetCluster: baudrate=100000000
    ethernet physical channel ChannelCommunication: category=WIRED, comm-connectors=CN_ZAFL_EthernetCluster
      pdu triggering PT_ACMIVA20msACUCrashInfoEvent: pdu=pdu_ACMIVA20msACUCrashInfoEvent, from ZAFL
      pdu triggering PT_ACMIVA20msACUOccupantStatusEvent: pdu=pdu_ACMIVA20msACUOccupantStatusEvent, from ZAFL
      pdu triggering PT_ACMZARight20msACUCrashInfoEvent: pdu=pdu_ACMZARight20msACUCrashInfoEvent, from ZAFL
      pdu triggering PT_ACMZARight20msACUOccupantStatusEvent: pdu=pdu_ACMZARight20msACUOccupantStatusEvent, from ZAFL
      pdu triggering PT_ACMZARear20msACUCrashInfoEvent: pdu=pdu_ACMZARear20msACUCrashInfoEvent, from ZAFL
      pdu triggering PT_ACMZARear20msACUOccupantStatusEvent: pdu=pdu_ACMZARear20msACUOccupantStatusEvent, from ZAFL
      pdu triggering PT_SD_Ctrl_Rx_Multicast: pdu=SD_Ctrl_Rx_Multicast, to ZAFL
      pdu triggering PT_SD_Ctrl_PCU_Rx: pdu=SD_Ctrl_Rx_ZAFL, to ZAFL
      pdu triggering PT_SD_Ctrl_PCU_Tx: pdu=SD_Ctrl_Tx_ZAFL, from ZAFL
      6 x network endpoint:
        NEP_ANY_SD: network-endpoint-addresses=ipv-4-configuration=ipv-4-address=ANY
        NEP_MC
          network-endpoint-addresses:
            ipv-4-configuration={ipv-4-address=239.192.255.251, ipv-4-address-source=FIXED}
            mac-multicast-configuration=MulticastMacAddress
        NEP_PCU: network-endpoint-addresses=ipv-4-configuration={ipv-4-address=192.168.1.2, ipv-4-address-source=FIXED, network-mask=255.255.255.0}
        NEP_IVA: network-endpoint-addresses=ipv-4-configuration={ipv-4-address=192.168.1.1, ipv-4-address-source=FIXED, network-mask=255.255.255.0}
        NEP_ZA_Right: network-endpoint-addresses=ipv-4-configuration={ipv-4-address=192.168.1.3, ipv-4-address-source=FIXED, network-mask=255.255.255.0}
        NEP_ZA_Rear: network-endpoint-addresses=ipv-4-configuration={ipv-4-address=192.168.1.4, ipv-4-address-source=FIXED, network-mask=255.255.255.0}
      so-ad-config:
        6 x socket connection bundle:
          SCB_PCU: server-port=SA_PCU
            bundled-connections:
              {client-port=SA_IVA_PCU, pdus=[{header-id=1343062273, pdu-triggering=PT_ACMIVA20msACUCrashInfoEvent, routing-group=SoAdRG_PCU_ACMIVAEvents_PEG}, {header-id=1343062529, pdu-triggering=PT_ACMIVA20msACUOccupantStatusEvent, routing-group=SoAdRG_PCU_ACMIVAEvents_PEG}], short-label=SC_PCU_IVA}
              {client-port=SA_ZA_Right_PCU, pdus=[{header-id=1343062274, pdu-triggering=PT_ACMZARight20msACUCrashInfoEvent, routing-group=SoAdRG_PCU_ACMZARightEvents_PEG}, {header-id=1343062530, pdu-triggering=PT_ACMZARight20msACUOccupantStatusEvent, routing-group=SoAdRG_PCU_ACMZARightEvents_PEG}], short-label=SC_PCU_ZA_Right}
              {client-port=SA_ZA_Rear_PCU, pdus=[{header-id=1343062275, pdu-triggering=PT_ACMZARear20msACUCrashInfoEvent, routing-group=SoAdRG_PCU_ACMZARearEvents_PEG}, {header-id=1343062531, pdu-triggering=PT_ACMZARear20msACUOccupantStatusEvent, routing-group=SoAdRG_PCU_ACMZARearEvents_PEG}], short-label=SC_PCU_ZA_Rear}
          SD_SCB_PCU: socket-connection{client-ip-addr-from-connection-request=true, client-port-from-connection-request=true, client-port=SD_SA_ANY, pdus=[{header-id=4294934784, pdu-triggering=PT_SD_Ctrl_PCU_Rx}, {header-id=4294934784, pdu-triggering=PT_SD_Ctrl_PCU_Tx}], short-label=SD_SCB_PCU_SC}, server-port=SD_SA_PCU
          SD_SCB_IVA: socket-connection=SD_SA_ANY, server-port=SD_SA_IVA
          SD_SCB_ZA_Right: socket-connection=SD_SA_ANY, server-port=SD_SA_ZA_Right
          SD_SCB_ZA_Rear: socket-connection=SD_SA_ANY, server-port=SD_SA_ZA_Rear
          SD_SCB_MC: socket-connection{client-ip-addr-from-connection-request=true, client-port-from-connection-request=true, client-port=SD_SA_ANY, pdus=socket-connection-ipdu-identifier={header-id=4294934784, pdu-triggering=PT_SD_Ctrl_Rx_Multicast}, short-label=SD_SCB_MC_SC}, server-port=SD_SA_MC
        10 x socket address:
          SA_PCU: connector=CN_ZAFL_EthernetCluster
            application endpoint AEP_PCU: network-endpoint=NEP_PCU, tp-configuration=udp-tp=udp-tp-port=port-number=40131
              provided service instance PSI_PCU:
                routing-group=[SoAdRG_PCU_ACMIVAEvents_PEG, SoAdRG_PCU_ACMZARightEvents_PEG, SoAdRG_PCU_ACMZARearEvents_PEG]
                instance-identifier=24589
                sd-server-config={initial-offer-behavior={initial-delay-max-value=0.05, initial-delay-min-value=0.05, initial-repetitions-base-delay=0.1, initial-repetitions-max=3}, offer-cyclic-delay=2, request-response-delay={max-value=0.2, min-value=0.02}, server-service-major-version=1, server-service-minor-version=0, ttl=3}
                service-identifier=20493
                event handler EH_ACMIVAEvents: consumed-event-group=CEG_ACMIVAEvents, multicast-threshold=0, routing-group=SoAdRG_PCU_ACMIVAEvents_PEG, sd-server-config={request-response-delay={max-value=0.2, min-value=0.02}, ttl=3}
                event handler EH_ACMZARightEvents: consumed-event-group=CEG_ACMZARightEvents, multicast-threshold=0, routing-group=SoAdRG_PCU_ACMZARightEvents_PEG, sd-server-config={request-response-delay={max-value=0.2, min-value=0.02}, ttl=3}
                event handler EH_ACMZARearEvents: consumed-event-group=CEG_ACMZARearEvents, multicast-threshold=0, routing-group=SoAdRG_PCU_ACMZARearEvents_PEG, sd-server-config={request-response-delay={max-value=0.2, min-value=0.02}, ttl=3}
          SA_IVA_PCU
            application endpoint AEP_IVA_PCU: network-endpoint=NEP_IVA, tp-configuration=udp-tp=udp-tp-port=port-number=40011
              consumed service instance CSI_IVA_PCU: routing-group=SoAdRG_PCU_ACMIVAEvents_PEG, provided-service-instance=PSI_PCU, sd-client-config={client-service-major-version=1, client-service-minor-version=0, initial-find-behavior={initial-delay-max-value=0.05, initial-delay-min-value=0.05, initial-repetitions-base-delay=0.1, initial-repetitions-max=3}, ttl=3}
                consumed event group CEG_ACMIVAEvents: application-endpoint=AEP_IVA_PCU, event-group-identifier=1, routing-group=SoAdRG_PCU_ACMIVAEvents_PEG, sd-client-config={request-response-delay={max-value=0.2, min-value=0.02}, ttl=3}
          SA_ZA_Right_PCU
            application endpoint AEP_ZA_Right_PCU: network-endpoint=NEP_ZA_Right, tp-configuration=udp-tp=udp-tp-port=port-number=40011
              consumed service instance CSI_ZA_Right_PCU: routing-group=SoAdRG_PCU_ACMZARightEvents_PEG, provided-service-instance=PSI_PCU, sd-client-config={client-service-major-version=1, client-service-minor-version=0, initial-find-behavior={initial-delay-max-value=0.05, initial-delay-min-value=0.05, initial-repetitions-base-delay=0.1, initial-repetitions-max=3}, ttl=3}
                consumed event group CEG_ACMZARightEvents: application-endpoint=AEP_ZA_Right_PCU, event-group-identifier=3, routing-group=SoAdRG_PCU_ACMZARightEvents_PEG, sd-client-config={request-response-delay={max-value=0.2, min-value=0.02}, ttl=3}
          SA_ZA_Rear_PCU
            application endpoint AEP_ZA_Rear_PCU: network-endpoint=NEP_ZA_Rear, tp-configuration=udp-tp=udp-tp-port=port-number=40011
              consumed service instance CSI_ZA_Rear_PCU: routing-group=SoAdRG_PCU_ACMZARearEvents_PEG, provided-service-instance=PSI_PCU, sd-client-config={client-service-major-version=1, client-service-minor-version=0, initial-find-behavior={initial-delay-max-value=0.05, initial-delay-min-value=0.05, initial-repetitions-base-delay=0.1, initial-repetitions-max=3}, ttl=3}
                consumed event group CEG_ACMZARearEvents: application-endpoint=AEP_ZA_Rear_PCU, event-group-identifier=4, routing-group=SoAdRG_PCU_ACMZARearEvents_PEG, sd-client-config={request-response-delay={max-value=0.2, min-value=0.02}, ttl=3}
          SD_SA_ANY
            application endpoint SD_AEP_ANY: network-endpoint=NEP_ANY_SD, tp-configuration=udp-tp=udp-tp-port=dynamically-assigned=true
          SD_SA_PCU
            application endpoint SD_AEP_PCU: network-endpoint=NEP_PCU, tp-configuration=udp-tp=udp-tp-port=port-number=30490
          SD_SA_IVA
            application endpoint SD_AEP_IVA: network-endpoint=NEP_IVA, tp-configuration=udp-tp=udp-tp-port=port-number=30490
          SD_SA_ZA_Right
            application endpoint SD_AEP_ZA_Right: network-endpoint=NEP_ZA_Right, tp-configuration=udp-tp=udp-tp-port=port-number=30490
          SD_SA_ZA_Rear
            application endpoint SD_AEP_ZA_Rear: network-endpoint=NEP_ZA_Rear, tp-configuration=udp-tp=udp-tp-port=port-number=30490
          SD_SA_MC: multicast-connector=CN_ZAFL_EthernetCluster
            application endpoint SD_AEP_MC: network-endpoint=NEP_MC, tp-configuration=udp-tp=udp-tp-port=port-number=30490
      vlan Vlan: vlan-identifier=5
    mac multicast group MulticastMacAddress: mac-multicast-address=01:00:5E:00:00:00
package /Topology/HardwareComponents
  ecu instance ZAFL: com-configuration-tx-time-base=0.01, sleep-mode-supported=false, wake-up-over-bus-supported=false
    ethernet communication controller CT_ZAFL_EthernetCluster: category=WIRED, mac-unicast-address=02:20:00:00:00:02
      coupling port CN_ZAFL_EthernetCluster: physical-layer-type=100BASE-T1, vlan-membership{default-priority=6, vlan=ChannelCommunication}
    ethernet communication connector CN_ZAFL_EthernetCluster: category=WIRED, comm-controller=CT_ZAFL_EthernetCluster, network-endpoint=[NEP_MC, NEP_PCU, NEP_IVA, NEP_ZA_Right, NEP_ZA_Rear]
