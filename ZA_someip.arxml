AUTOSAR XML (schema 00046)
standard types defined: float32, uint32, uint8
package /Communication/DataTransformation
  data transformation set TransformerConfiguration
    data transformation SomeIpDefaultTransformation: execute-despite-data-unavailability=false, transformer-chain=SomeIpDefaultTransformer
    transformation technology SomeIpDefaultTransformer: buffer-properties={header-length=64, in-place=false}, protocol=SOMEIP, someip-transformation-description{alignment=8, byte-order=little-endian, interface-version=1}, transformer-class=SERIALIZER, version=1.0.0
package /Communication/PDUs
  general purpose pdu SD_Ctrl_Rx_Multicast: category=SD, length=1500
  general purpose pdu SD_Ctrl_Rx_ZAFL: category=SD, length=1500
  general purpose pdu SD_Ctrl_Tx_ZAFL: category=SD, length=1500
  pdu pdu_PCUIVA10msEvent: length=27, transmission-mode-true-timing=event-controlled-timing=number-of-repetitions=0
    signal sig_PCUIVA10msEvent: start 0, 27 bit, opaque, system signal sys_PCUIVA10msEvent, data-transformations=SomeIpDefaultTransformation, data-type-policy=TRANSFORMING-I-SIGNAL, someip-transformation-i-signal-props{transformer=SomeIpDefaultTransformer, interface-version=1, message-type=NOTIFICATION}, transfer-property=TRIGGERED-WITHOUT-REPETITION
  pdu pdu_PCUIVA50msEvent: length=20, transmission-mode-true-timing=event-controlled-timing=number-of-repetitions=0
    signal sig_PCUIVA50msEvent: start 0, 20 bit, opaque, system signal sys_PCUIVA50msEvent, data-transformations=SomeIpDefaultTransformation, data-type-policy=TRANSFORMING-I-SIGNAL, someip-transformation-i-signal-props{transformer=SomeIpDefaultTransformer, interface-version=1, message-type=NOTIFICATION}, transfer-property=TRIGGERED-WITHOUT-REPETITION
  pdu pdu_RMCUZALeft10msEvent: length=26, unused-bit-pattern=0
    signal sig_RMCUZALeft10msEvent: start 0, 26 bit, opaque, system signal sys_RMCUZALeft10msEvent, data-transformations=SomeIpDefaultTransformation, data-type-policy=TRANSFORMING-I-SIGNAL, someip-transformation-i-signal-props{transformer=SomeIpDefaultTransformer, interface-version=1, message-type=NOTIFICATION}, transfer-property=TRIGGERED-WITHOUT-REPETITION, to ZAFL
package /SoAdRoutingGroups
  so ad routing group SoAdRG_PCU_PCUIVAEvents_PEG: event-group-control-type=ACTIVATION-UNICAST
  so ad routing group SoAdRG_RMCU_RMCUZALeftEvents_CEG: event-group-control-type=ACTIVATION-UNICAST
package /System
  system System: category=ECU_SYSTEM_DESCRIPTION
package /PortInterfaces
  sender receiver interface SoIp_I_P_PCUIVA10msEvent
    data PCUIVA10msEvent: type=PCUIVA10msStruct
  sender receiver interface SoIp_I_P_PCUIVA50msEvent
    data PCUIVA50msEvent: type=PCUIVA50msStruct
  sender receiver interface SoIp_I_C_RMCUZALeft10msEvent
    data RMCUZALeft10msEvent: type=RMCUZALeft10msStruct
package /DataTypes
  impl type PCUIVA10msStruct: category=STRUCTURE, sw-calibration-access=READ-ONLY, type-emitter=RTE
    element emsReqSensorInfo1: category=STRUCTURE, sw-calibration-access=READ-ONLY
      10 x element, all with category=VALUE:
        crashOtptSts: base-type=uint8, compu {0=CRASH_OTPT_STS_NO_EVENT (CompuScale), 1=CRASH_OTPT_STS_CRASH_DETECTED (CompuScale_1)}, range raw 0..255
        isgTrqAchvd: base-type=float32, sw-calibration-access=READ-ONLY
        pCUBCMRemoteFunctionState: base-type=uint8, compu {0=PCUBCM_REMOTE_FUNCTION_STATE_NORMAL_FUNCTION (CompuScale), 1=PCUBCM_REMOTE_FUNCTION_STATE_REMOTE_FUNCTION (CompuScale_1), 2=PCUBCM_REMOTE_FUNCTION_STATE_RESERVED (CompuScale_2), 3=PCUBCM_REMOTE_FUNCTION_STATE_SIGNAL_INVALID (CompuScale_3)}, range raw 0..255
        pCUBMSSocActualEST: base-type=float32, sw-calibration-access=READ-ONLY
        pCUCVCACTGear: base-type=uint8, compu {0=PCUCVCACT_GEAR_P (CompuScale), 1=PCUCVCACT_GEAR_R (CompuScale_1), 2=PCUCVCACT_GEAR_N (CompuScale_2), 3=PCUCVCACT_GEAR_D (CompuScale_3), 4=PCUCVCACT_GEAR_RESERVED (CompuScale_4), 5=PCUCVCACT_GEAR_RESERVED_2 (CompuScale_5), 6=PCUCVCACT_GEAR_RESERVED_3 (CompuScale_6), 7=PCUCVCACT_GEAR_FAULT (CompuScale_7)}, range raw 0..255
        pCUCVCACTGearValid: base-type=uint8, compu {0=PCUCVCACT_GEAR_VALID_VALID (CompuScale), 1=PCUCVCACT_GEAR_VALID_INVALID (CompuScale_1)}, range raw 0..255
        pCUVehicleOperationState:
          base-type=uint8
          compu {0=PCU_VEHICL_OPERATION_STATE_OFF_COMFORT_ENABLE (CompuScale), 1=PCU_VEHICL_OPERATION_STATE_ACC_PARK (CompuScale_1), 2=PCU_VEHICL_OPERATION_STATE_ON_DRIVER_PRESENT (CompuScale_2), 3=PCU_VEHICL_OPERATION_STATE_ENGINE_START_E_MOTOR_RUNNING (CompuScale_3), 4=PCU_VEHICL_OPERATION_STATE_SW_UPDATE_OTA (CompuScale_4), 5=PCU_VEHICL_OPERATION_STATE_RESERVED (CompuScale_5), 6=PCU_VEHICL_OPERATION_STATE_RESERVED_2 (CompuScale_6), 7=PCU_VEHICL_OPERATION_STATE_SIGNAL_INVALID (CompuScale_7)}
          range raw 0..255
        propSysAsta: base-type=uint8, compu {0=PROP_SYS_A_STA_NOT_READY (CompuScale), 1=PROP_SYS_A_STA_READY (CompuScale_1)}, range raw 0..255
        vehSpd: base-type=float32, sw-calibration-access=READ-ONLY
        vehSpdValid: base-type=uint8, compu {0=VEH_SPD_VALID_VALID (CompuScale), 1=VEH_SPD_VALID_INVALID (CompuScale_1)}, range raw 0..255
  impl type PCUIVA50msStruct: category=STRUCTURE, sw-calibration-access=READ-ONLY, type-emitter=RTE
    element emsReqSensorInfo2: category=STRUCTURE, sw-calibration-access=READ-ONLY
      element accelPdlPos: category=VALUE, base-type=float32, sw-calibration-access=READ-ONLY
      element otsdTemp: category=VALUE, base-type=float32, sw-calibration-access=READ-ONLY
      element totalOdometer: category=VALUE, base-type=uint32, sw-calibration-access=READ-ONLY
  impl type RMCUZALeft10msStruct: category=STRUCTURE, sw-calibration-access=READ-ONLY, type-emitter=RTE
    element rmcuAbility: category=STRUCTURE, sw-calibration-access=READ-ONLY
      6 x element, all with category=VALUE:
        rMCUActInputCurrent: base-type=float32, sw-calibration-access=READ-ONLY
        rMCUActInputCurrentV: base-type=uint8, compu {0=RMCU_ACT_INPUT_CURRENT_V_VALID (CompuScale), 1=RMCU_ACT_INPUT_CURRENT_V_INVALID (CompuScale_1)}, range raw 0..255
        rMCUActInputVolt: base-type=float32, sw-calibration-access=READ-ONLY
        rMCUActInputVoltV: base-type=uint8, compu {0=RMCU_ACT_INPUT_VOLT_V_VALID (CompuScale), 1=RMCU_ACT_INPUT_VOLT_V_INVALID (CompuScale_1)}, range raw 0..255
        rMCUCVCNegTrqLmt: base-type=float32, sw-calibration-access=READ-ONLY
        rMCUCVCPosTrqLmt: base-type=float32, sw-calibration-access=READ-ONLY
package /Topology/Clusters
  ethernet cluster EthernetCluster: baudrate=100000000
    ethernet physical channel ChannelCommunication: category=WIRED, comm-connectors=CN_ZAFL_EthernetCluster
      pdu triggering PT_PCUIVA10msEvent: pdu=pdu_PCUIVA10msEvent, from ZAFL
      pdu triggering PT_PCUIVA50msEvent: pdu=pdu_PCUIVA50msEvent, from ZAFL
      pdu triggering PT_RMCUZALeft10msEvent: pdu=pdu_RMCUZALeft10msEvent, to ZAFL
      pdu triggering PT_SD_Ctrl_Rx_Multicast: pdu=SD_Ctrl_Rx_Multicast, to ZAFL
      pdu triggering PT_SD_Ctrl_PCU_Rx: pdu=SD_Ctrl_Rx_ZAFL, to ZAFL
      pdu triggering PT_SD_Ctrl_PCU_Tx: pdu=SD_Ctrl_Tx_ZAFL, from ZAFL
      4 x network endpoint:
        NEP_ANY_SD: network-endpoint-addresses=ipv-4-configuration=ipv-4-address=ANY
        NEP_MC
          network-endpoint-addresses:
            ipv-4-configuration={ipv-4-address=239.192.255.251, ipv-4-address-source=FIXED}
            mac-multicast-configuration=MulticastMacAddress
        NEP_PCU: network-endpoint-addresses=ipv-4-configuration={ipv-4-address=192.168.1.2, ipv-4-address-source=FIXED, network-mask=255.255.255.0}
        NEP_IVA: network-endpoint-addresses=ipv-4-configuration={ipv-4-address=192.168.1.1, ipv-4-address-source=FIXED, network-mask=255.255.255.0}
      so-ad-config:
        5 x socket connection bundle:
          SCB_PCU: socket-connection{client-port=SA_IVA_PCU, pdus=[{header-id=1343062017, pdu-triggering=PT_PCUIVA10msEvent, routing-group=SoAdRG_PCU_PCUIVAEvents_PEG}, {header-id=1343062018, pdu-triggering=PT_PCUIVA50msEvent, routing-group=SoAdRG_PCU_PCUIVAEvents_PEG}], short-label=SC_PCU_IVA}, server-port=SA_PCU
          SCB_RMCU: socket-connection{client-port=SA_RMCU, pdus=socket-connection-ipdu-identifier={header-id=1343193090, pdu-triggering=PT_RMCUZALeft10msEvent, routing-group=SoAdRG_RMCU_RMCUZALeftEvents_CEG}, short-label=SC_RMCU_IVA}, server-port=SA_IVA_RMCU
          SD_SCB_PCU: socket-connection{client-ip-addr-from-connection-request=true, client-port-from-connection-request=true, client-port=SD_SA_ANY, pdus=[{header-id=4294934784, pdu-triggering=PT_SD_Ctrl_PCU_Rx}, {header-id=4294934784, pdu-triggering=PT_SD_Ctrl_PCU_Tx}], short-label=SD_SCB_PCU_SC}, server-port=SD_SA_PCU
          SD_SCB_IVA: socket-connection=SD_SA_ANY, server-port=SD_SA_IVA
          SD_SCB_MC: socket-connection{client-ip-addr-from-connection-request=true, client-port-from-connection-request=true, client-port=SD_SA_ANY, pdus=socket-connection-ipdu-identifier={header-id=4294934784, pdu-triggering=PT_SD_Ctrl_Rx_Multicast}, short-label=SD_SCB_MC_SC}, server-port=SD_SA_MC
        8 x socket address:
          SA_PCU: connector=CN_ZAFL_EthernetCluster
            application endpoint AEP_PCU: network-endpoint=NEP_PCU, tp-configuration=udp-tp=udp-tp-port=port-number=40131
              provided service instance PSI_PCU:
                routing-group=SoAdRG_PCU_PCUIVAEvents_PEG
                instance-identifier=24589
                sd-server-config={initial-offer-behavior={initial-delay-max-value=0.05, initial-delay-min-value=0.05, initial-repetitions-base-delay=0.1, initial-repetitions-max=3}, offer-cyclic-delay=2, request-response-delay={max-value=0.2, min-value=0.02}, server-service-major-version=1, server-service-minor-version=0, ttl=3}
                service-identifier=20493
                event handler EH_PCUIVAEvents: consumed-event-group=CEG_PCUIVAEvents, multicast-threshold=0, routing-group=SoAdRG_PCU_PCUIVAEvents_PEG, sd-server-config={request-response-delay={max-value=0.2, min-value=0.02}, ttl=3}
          SA_IVA_PCU
            application endpoint AEP_IVA_PCU: network-endpoint=NEP_IVA, tp-configuration=udp-tp=udp-tp-port=port-number=40131
              consumed service instance CSI_IVA_PCU: routing-group=SoAdRG_PCU_PCUIVAEvents_PEG, provided-service-instance=PSI_PCU, sd-client-config={client-service-major-version=1, client-service-minor-version=0, initial-find-behavior={initial-delay-max-value=0.05, initial-delay-min-value=0.05, initial-repetitions-base-delay=0.1, initial-repetitions-max=3}, ttl=3}
                consumed event group CEG_PCUIVAEvents: application-endpoint=AEP_IVA_PCU, event-group-identifier=1, routing-group=SoAdRG_PCU_PCUIVAEvents_PEG, sd-client-config={request-response-delay={max-value=0.2, min-value=0.02}, ttl=3}
          SA_RMCU: connector=CN_ZAFL_EthernetCluster
            application endpoint AEP_RMCU: network-endpoint=NEP_PCU, tp-configuration=udp-tp=udp-tp-port=port-number=40152
              consumed service instance CSI_RMCU: routing-group=SoAdRG_RMCU_RMCUZALeftEvents_CEG, provided-service-instance=PSI_IVA_RMCU, sd-client-config={client-service-major-version=1, client-service-minor-version=0, initial-find-behavior={initial-delay-max-value=0.05, initial-delay-min-value=0.05, initial-repetitions-base-delay=0.1, initial-repetitions-max=3}, ttl=3}
                consumed event group CEG_RMCUZALeftEvents: application-endpoint=AEP_RMCU, event-group-identifier=2, routing-group=SoAdRG_RMCU_RMCUZALeftEvents_CEG, sd-client-config={request-response-delay={max-value=0.2, min-value=0.02}, ttl=3}
          SA_IVA_RMCU
            application endpoint AEP_IVA_RMCU: network-endpoint=NEP_IVA, tp-configuration=udp-tp=udp-tp-port=port-number=30500
              provided service instance PSI_IVA_RMCU:
                routing-group=SoAdRG_RMCU_RMCUZALeftEvents_CEG
                instance-identifier=24591
                sd-server-config={initial-offer-behavior={initial-delay-max-value=0.05, initial-delay-min-value=0.05, initial-repetitions-base-delay=0.1, initial-repetitions-max=3}, offer-cyclic-delay=2, request-response-delay={max-value=0.2, min-value=0.02}, server-service-major-version=1, server-service-minor-version=0, ttl=3}
                service-identifier=20495
                event handler EH_RMCUZALeftEvents: application-endpoint=AEP_IVA_RMCU, consumed-event-group=CEG_RMCUZALeftEvents
          SD_SA_ANY
            application endpoint SD_AEP_ANY: network-endpoint=NEP_ANY_SD, tp-configuration=udp-tp=udp-tp-port=dynamically-assigned=true
          SD_SA_PCU
            application endpoint SD_AEP_PCU: network-endpoint=NEP_PCU, tp-configuration=udp-tp=udp-tp-port=port-number=30490
          SD_SA_IVA
            application endpoint SD_AEP_IVA: network-endpoint=NEP_IVA, tp-configuration=udp-tp=udp-tp-port=port-number=30490
          SD_SA_MC: multicast-connector=CN_ZAFL_EthernetCluster
            application endpoint SD_AEP_MC: network-endpoint=NEP_MC, tp-configuration=udp-tp=udp-tp-port=port-number=30490
      vlan Vlan: vlan-identifier=5
    mac multicast group MulticastMacAddress: mac-multicast-address=01:00:5E:00:00:00
package /Topology/HardwareComponents
  ecu instance ZAFL: com-configuration-tx-time-base=0.01, sleep-mode-supported=false, wake-up-over-bus-supported=false
    ethernet communication controller CT_ZAFL_EthernetCluster: category=WIRED, mac-unicast-address=02:20:00:00:00:02
      coupling port CN_ZAFL_EthernetCluster: physical-layer-type=100BASE-T1, vlan-membership{default-priority=6, vlan=ChannelCommunication}
    ethernet communication connector CN_ZAFL_EthernetCluster: category=WIRED, comm-controller=CT_ZAFL_EthernetCluster, network-endpoint=[NEP_MC, NEP_PCU, NEP_IVA]
